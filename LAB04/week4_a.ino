#define PI 3.1415926535897932384626433832795
double y[75]={-87.17307638,-109.5495333,11.00037444,163.4286511,199.1497693,123.5660003,56.25558579,11.87495703,-18.97729813,-42.98507139,-49.50432452,-44.95819516,-33.93206642,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-17.77934267
};
double x[75];
int N = 75;
//int n,k;
//double real = cos((-1*2*PI*k*n)/N);
//double img = sin((-1*2*PI*k*n)/N);
double real_w[75][75];
double img_w[75][75];
double dft_real[75],dft_img[75],dft_mag[75];
void setup() {
  // put your setup code here, to run once:
Serial.begin(9600);

for(int i=0;i<75;i++){
  for(int j=0;j<6;j++){
    x[i]= x[i]+ y[i-j];
  }
  x[i]=x[i]/6;
 
}

for(int i=0;i<N;i++){
  for(int j=0;j<N;j++){
    real_w[i][j] = cos((-1*2*PI*i*j)/N);
    img_w[i][j] = sin((-1*2*PI*i*j)/N);
  }
}
for(int i=0;i<N;i++){
  int sum_real=0,sum_img=0;
  for(int j=0;j<N;j++){
    sum_real = sum_real+real_w[i][j]*x[j];
    sum_img = sum_img+img_w[i][j]*x[j];
  }
  dft_real[i] = sum_real;
  dft_img[i] = sum_img;
  dft_mag[i] = sqrt((sum_real*sum_real)+(sum_img*sum_img));
  //Serial.println(dft_mag[i]);
}

int maxk = 0;
for(int i=0;i<N/2;i++){
  if(dft_mag[maxk] < dft_mag[i]){
    maxk = i;
  }
}

float fmax = maxk*25;
fmax = fmax/75;
float bpm = fmax*60;
Serial.println(maxk);
Serial.println(fmax);
Serial.println(bpm);


 
}

void loop() {
  // put your main code here, to run repeatedly:

}
